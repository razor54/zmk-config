## boards/shields/corne_peripheral_left/Kconfig.defconfig
```kconfig
if SHIELD_CORNE_PERIPHERAL_LEFT

config ZMK_KEYBOARD_NAME
	default "Corne Peripheral Left"

config ZMK_SPLIT
	default y

config ZMK_SPLIT_ROLE_PERIPHERAL
	bool
	default y

endif
```

## boards/shields/corne_peripheral_left/Kconfig.shield
```kconfig
config SHIELD_CORNE_PERIPHERAL_LEFT
	def_bool $(shields_list_contains,corne_peripheral_left)
```

## boards/shields/corne_peripheral_right/Kconfig.defconfig
```kconfig
if SHIELD_CORNE_PERIPHERAL_RIGHT

config ZMK_KEYBOARD_NAME
	default "Corne Peripheral Right"

config ZMK_SPLIT
	default y

config ZMK_SPLIT_ROLE_PERIPHERAL
	bool
	default y

endif
```

## boards/shields/corne_peripheral_right/Kconfig.shield
```kconfig
config SHIELD_CORNE_PERIPHERAL_RIGHT
    def_bool $(shields_list_contains,corne_peripheral_right)
```

## config/west.yml
```yaml
manifest:
  remotes:
    - name: zmkfirmware
      url-base: https://github.com/zmkfirmware
    - name: urob
      url-base: https://github.com/urob
    # dongle_display support
    - name: englmaxi
      url-base: https://github.com/englmaxi
    # nice_oled, nice_epaper, dongle_display!view, oled Adapter
    - name: mctechnology17
      url-base: https://github.com/mctechnology17
  projects:
    - name: zmk
      remote: zmkfirmware
      revision: main
      import: app/west.yml
    - name: zmk-helpers
      remote: urob
      revision: main
    # nice_oled and nice_epaper
    - name: zmk-nice-oled
      remote: mctechnology17
      revision: main
    # dongle_display support
    - name: zmk-dongle-display
      remote: englmaxi
      revision: main
    - name: zmk-dongle-display-view
      remote: mctechnology17
      revision: main
    - name: zmk-oled-adapter
      remote: mctechnology17
      revision: main
  self:
    path: config
```
